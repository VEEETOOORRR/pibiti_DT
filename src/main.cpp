// ============================================================================
// INCLUDES
// ============================================================================
#include <Arduino.h>
#include <Wire.h>
#include <Adafruit_INA219.h>
#include <Adafruit_ADS1X15.h>
#include <WiFi.h>
#include <PubSubClient.h>

// ============================================================================
// DEFINES E CONSTANTES - PINOS
// ============================================================================


// ============================================================================
// OBJETOS GLOBAIS
// ============================================================================

Adafruit_INA219 ina219;
Adafruit_ADS1115 ads;

// ============================================================================
// VARIÁVEIS GLOBAIS
// ============================================================================



// ============================================================================
// FUNÇÕES AUXILIARES
// ============================================================================

// ============================================================================
// SETUP
// ============================================================================
void setup(void) 
{

  Serial.begin(115200);
  Wire.begin();
    
  Serial.println("Hello!");

  if (!ina219.begin()) {
    Serial.println("Failed to find INA219 chip");
    while (1);
  }

  if (!ads.begin()) {
    Serial.println("Failed to initialize ADS.");
    while (1);
  }

  ads.setGain(GAIN_ONE);

}

// ============================================================================
// LOOP
// ============================================================================

void loop(void) 
{
  uint16_t adc0, adc1, adc2, adc3;
  float tensao;
  adc0 = ads.readADC_SingleEnded(1);
  tensao = ads.computeVolts(adc0);

  Serial.print("\nadc: "); Serial.print(adc0);
  Serial.print("\nvolts: "); Serial.print(tensao);

  delay(200);
}